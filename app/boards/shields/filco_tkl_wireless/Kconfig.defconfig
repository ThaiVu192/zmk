## app/boards/shields/filco_tkl_wireless/Kconfig.defconfig
```kconfig
# Copyright (c) 2026 The ZMK Contributors
# SPDX-License-Identifier: MIT

if SHIELD_FILCO_TKL_WIRELESS

config ZMK_KEYBOARD_NAME
    default "Filco TKL"

config ZMK_USB
    def_bool y

config ZMK_BLE
    def_bool y

config ZMK_HID_INDICATORS
    def_bool y

config I2C
    def_bool y

endif
```

## app/boards/shields/filco_tkl_wireless/Kconfig.shield
```kconfig
# Copyright (c) 2026 The ZMK Contributors
# SPDX-License-Identifier: MIT

config SHIELD_FILCO_TKL_WIRELESS
    def_bool $(shields_list_contains,filco_tkl_wireless)
```
